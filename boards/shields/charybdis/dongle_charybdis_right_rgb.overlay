/*
 * Charybdis right keyboard (dongle-mode peripheral) - RGB underglow variant.
 * Base shield + WS2812/SK6812 strip (27 LEDs) on spi3 MOSI (P1.13, nice!nano D15).
 */

#include "dongle_charybdis_right.overlay"

#define CHARYBDIS_RGB_CHAIN_LENGTH 27
#include "charybdis_rgb.dtsi"
#undef CHARYBDIS_RGB_CHAIN_LENGTH
