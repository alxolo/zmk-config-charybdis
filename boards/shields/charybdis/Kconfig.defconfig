## boards/shields/charybdis/Kconfig.defconfig
```kconfig
if SHIELD_CHARYBDIS_RIGHT_STANDALONE

config ZMK_KEYBOARD_NAME
	default "Charybdis"

config ZMK_SPLIT_BLE_ROLE_CENTRAL
	default y

endif

if SHIELD_DONGLE_CHARYBDIS_RIGHT

config ZMK_KEYBOARD_NAME
	default "Charybdis Right"

endif

if SHIELD_DONGLE_PROSPECTOR || SHIELD_DONGLE_BWSHOCKLEY_PROSPECTOR

config ZMK_KEYBOARD_NAME
	default "Charybdis"

config ZMK_SPLIT_BLE_ROLE_CENTRAL
	default y

endif

if SHIELD_DONGLE_ZDSE_PROSPECTOR

config ZMK_KEYBOARD_NAME
	default "Charybdis"

config ZMK_SPLIT_BLE_ROLE_CENTRAL
	default y

# ST7789V pixel format and backlight dependencies previously provided by
# carrefinho's prospector_adapter shield
choice ST7789V_PIXEL_FORMAT
	default ST7789V_RGB565
endchoice

config PWM
	default y

config LED
	default y

endif

if SHIELD_DONGLE_NICE

config ZMK_KEYBOARD_NAME
	default "Charybdis"

config ZMK_SPLIT_BLE_ROLE_CENTRAL
	default y

endif



if SHIELD_CHARYBDIS_LEFT || SHIELD_CHARYBDIS_RIGHT_STANDALONE || SHIELD_DONGLE_CHARYBDIS_RIGHT || SHIELD_DONGLE_PROSPECTOR || SHIELD_DONGLE_NICE || SHIELD_DONGLE_BWSHOCKLEY_PROSPECTOR || SHIELD_DONGLE_ZDSE_PROSPECTOR

config ZMK_SPLIT
	default y

endif
```

## boards/shields/charybdis/Kconfig.shield
```kconfig
config SHIELD_CHARYBDIS_LEFT
	def_bool $(shields_list_contains,charybdis_left)

config SHIELD_CHARYBDIS_LEFT_RGB
	def_bool $(shields_list_contains,charybdis_left_rgb)

config SHIELD_CHARYBDIS_RIGHT_STANDALONE
	def_bool $(shields_list_contains,charybdis_right_standalone)

config SHIELD_CHARYBDIS_RIGHT_STANDALONE_RGB
	def_bool $(shields_list_contains,charybdis_right_standalone_rgb)

config SHIELD_DONGLE_CHARYBDIS_RIGHT
	def_bool $(shields_list_contains,dongle_charybdis_right)

config SHIELD_DONGLE_CHARYBDIS_RIGHT_RGB
	def_bool $(shields_list_contains,dongle_charybdis_right_rgb)

config SHIELD_DONGLE_PROSPECTOR
	def_bool $(shields_list_contains,dongle_prospector)

config SHIELD_DONGLE_ZDSE_PROSPECTOR
	def_bool $(shields_list_contains,dongle_zdse_prospector)

config SHIELD_DONGLE_NICE
	def_bool $(shields_list_contains,dongle_nice)
```
